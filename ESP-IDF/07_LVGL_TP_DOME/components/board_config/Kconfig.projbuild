## ESP-IDF/07_LVGL_TP_DOME/components/board_config/Kconfig.projbuild
```kconfig
menu "HXESP4848AI0210DIC-A Board Configuration"
config BOARD_LCD_H_RES
    int "LCD horizontal resolution"
    default 480
config BOARD_LCD_V_RES
    int "LCD vertical resolution"
    default 480
endmenu
```
